## boards/shields/RetroPad/Kconfig.defconfig
```kconfig
if SHIELD_RETROPAD

config ZMK_KEYBOARD_NAME
    default "RetroPad"
    CONFIG_ZMK_BLE=y
    CONFIG_ZMK_USB=n
    CONFIG_ZMK_BLE_EXPERIMENTAL_FEATURES=y
    CONFIG_ZMK_BLE_EXPERIMENTAL_CONN=y
    CONFIG_ZMK_BLE_PASSKEY_ENTRY=n

endif 
```
